/dts-v1/;
/plugin/;

/{
    fragment@0{
        target-path = "/";
        __overlay__ {
            bone_led {
                compatible = "org,bone-gpio-sysfs";
                serial-num = "ABCDE123";
                status = "okay";
                size = <1024>;
                enable-feature;
                gpio_1 {
                    label = "gpio1.22";
                    bone-gpios = <&gpio1 21 0>;
                };
            };
        };
    };

    fragment@0{
        target-path="/demo_device";
        __overlay__{
            demo,serial-number="DEMODEVA";
            demo,buffer-size=1024;
        };
    };
};
