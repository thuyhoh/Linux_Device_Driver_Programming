/ {
    demo_device {
        compatible = "mycompany,demo-device";

        demo,serial-number = "DEMO001";
        demo,buffer-size = <512>;
        demo,channels = <1 3 5>;
        demo,enable-feature;

        status = "okay";
    };
};