/dts-v1/;
/plugin/;

#include <dt-bindings/gpio/gpio.h>
#include <dt-bindings/pinctrl/am33xx.h>

/ {
    compatible = "ti,am335x-bone-black", "ti,am335x-bone";

    fragment@0 {
        target = <&am33xx_pinmux>;
        __overlay__ {
            /* Pad offset 0x30 = P8_12 (gpmc_ad12), mux mode 7 = GPIO1_12 */
            my_irq_pins_default: my_irq_pins_default {
                pinctrl-single,pins = <
                    AM33XX_PADCONF(AM335X_PIN_GPMC_AD12, PIN_INPUT_PULLUP, MUX_MODE7)
                >;
            };
        };
    };

    fragment@1 {
        target-path = "/";
        __overlay__ {
            my_irq_dev {
                compatible = "custom,bbb-gpio-irq";
                pinctrl-names = "default";
                pinctrl-0 = <&my_irq_pins_default>;
                irq-gpios = <&gpio1 12 GPIO_ACTIVE_LOW>;
                status = "okay";
            };
        };
    };
};

